VERSION ""

NS_ :

BS_:

BU_: MotorController

BO_ 2147493890 TPDO2_Blower: 8 Vector__XXX
 SG_ VAR4_WandSpray : 32|32@1- (1,0) [0|1] "%" Vector__XXX
 SG_ VAR3_RightSpray : 0|32@1- (1,0) [0|1] "" Vector__XXX

BO_ 2147489794 TPDO1_Blower: 8 Vector__XXX
 SG_ VAR2_LeftSpray : 32|32@1- (1,0) [0|1] "" Vector__XXX
 SG_ VAR1_Blower : 0|32@1- (10,0) [0|100] "%" Vector__XXX

BA_DEF_  "BusType" STRING ;
BA_DEF_DEF_  "BusType" "CAN";
